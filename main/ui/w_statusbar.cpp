#include "ui/w_statusbar.h"
#include "ui/text_outline.h"
#include "ui/theme.h"
#include "hal/hal_power.h"
#include "hal/hal_rtc.h"
#include "hal/hal_sensors.h"

#include <cstdio>
#include <ctime>

#include <esp_log.h>

// Embedded by EMBED_FILES in main/CMakeLists.txt.
extern const unsigned char statusbar_png_start[] asm("_binary_statusbar_png_start");
extern const unsigned char statusbar_png_end[]   asm("_binary_statusbar_png_end");

namespace ui {
namespace {

/// FreeSans/DejaVu GFX fonts only cover ASCII 0x20-0x7E, so there is no
/// degree glyph. Drawing a small ring is cheaper than shipping a custom font.
void drawDegreeRing(M5GFX& g, int16_t x, int16_t y, uint32_t color) {
    g.drawCircle(x, y, 3, color);
    g.drawCircle(x, y, 2, color);
}

/// Blit the pre-dithered gradient generated by tools/gen_chrome.py.
///
/// The gradient is built at full colour depth on the host and error-diffused
/// onto the panel's six inks there, because a six-ink panel cannot render a
/// smooth sweep directly and flat bands look like flat bands. Falling back to
/// bands only if the blob is somehow unusable.
void drawStatusBackground(M5GFX& g, const Rect& b) {
    if (g.drawPng(statusbar_png_start,
                  static_cast<uint32_t>(statusbar_png_end - statusbar_png_start),
                  b.x, b.y, b.w, b.h)) {
        return;
    }
    ESP_LOGW("statusbar", "gradient blit failed; falling back to flat bands");
    for (int i = 0; i < theme::kStatusBandCount; ++i) {
        const int16_t x0 =
            static_cast<int16_t>(b.x + (b.w * i) / theme::kStatusBandCount);
        const int16_t x1 =
            static_cast<int16_t>(b.x + (b.w * (i + 1)) / theme::kStatusBandCount);
        g.fillRect(x0, b.y, static_cast<int16_t>(x1 - x0), b.h,
                   theme::kStatusBands[i]);
    }
}

/// One text helper for both themes: over the rainbow the text needs a white
/// fill and a black outline to survive four different backgrounds; on a plain
/// white bar a flat colour is cleaner.
void barText(M5GFX& g, const char* s, int16_t x, int16_t cy,
             const text::FontPick& pick, uint32_t flat_color,
             textdatum_t datum) {
    if (!theme::kStatusRainbow) {
        text::draw(g, s, x, cy, pick, flat_color, datum);
        return;
    }
    text::drawOutlinedAt(g, s, x, cy, pick, theme::kWhite, theme::kBlack,
                         theme::kStatusTextOutlineRadius, datum);
}

/// A small battery outline with a proportional fill. Drawn rather than
/// written because the GFX fonts have no battery glyph, and a shape reads
/// faster than a number for a child (and for an adult across the room).
void drawBattery(M5GFX& g, int16_t x, int16_t cy, const hal::power::Battery& b) {
    constexpr int16_t kW = 26, kH = 13, kNubW = 3, kNubH = 6;
    const int16_t y = static_cast<int16_t>(cy - kH / 2);

    // White backing so the outline survives the gradient behind it.
    g.fillRect(static_cast<int16_t>(x - 1), static_cast<int16_t>(y - 1),
               static_cast<int16_t>(kW + kNubW + 3), static_cast<int16_t>(kH + 2),
               theme::kWhite);
    g.drawRect(x, y, kW, kH, theme::kBlack);
    g.fillRect(static_cast<int16_t>(x + kW), static_cast<int16_t>(cy - kNubH / 2),
               kNubW, kNubH, theme::kBlack);

    if (!b.valid) {
        // Unknown: a question mark rather than a misleading empty cell.
        const text::FontPick tiny{&fonts::FreeSansBold9pt7b, 1.0f};
        text::draw(g, "?", static_cast<int16_t>(x + kW / 2), cy, tiny,
                   theme::kBlack, textdatum_t::middle_center);
        return;
    }

    const int16_t inner = static_cast<int16_t>(kW - 4);
    const int16_t fill = static_cast<int16_t>((inner * b.percent) / 100);
    // Red below 20% so a flat battery is obvious at a glance -- this device
    // has a habit of being hard to wake when the cell is low.
    const uint32_t colour = (b.percent < 20) ? theme::kRed
                          : (b.percent < 50) ? theme::kYellow
                                             : theme::kGreen;
    if (fill > 0) {
        g.fillRect(static_cast<int16_t>(x + 2), static_cast<int16_t>(y + 2), fill,
                   static_cast<int16_t>(kH - 4), colour);
    }
    if (b.charging) {
        // A bolt is fiddly at this size; a filled centre dot reads clearly.
        g.fillCircle(static_cast<int16_t>(x + kW / 2), cy, 3, theme::kBlue);
        g.drawCircle(static_cast<int16_t>(x + kW / 2), cy, 4, theme::kWhite);
    }
}

}  // namespace

void StatusBar::draw(M5GFX& g) {
    const Rect& b = bounds_;

    if (theme::kStatusRainbow) {
        drawStatusBackground(g, b);
    }

    const std::time_t now = std::time(nullptr);
    std::tm tm{};
    localtime_r(&now, &tm);

    // A clock that was only seeded from the firmware build stamp is flagged on
    // the device itself, not just in the serial log.
    const bool suspect = hal::rtc::timeIsSuspect();
    const uint32_t time_flat = suspect ? theme::kRed : theme::kInk;

    // --- Time (large, left) ---
    char clock[16];
    std::snprintf(clock, sizeof(clock), "%02d:%02d%s", tm.tm_hour, tm.tm_min,
                  suspect ? "?" : "");
    const text::FontPick time_font{&fonts::FreeSansBold18pt7b, 1};
    barText(g, clock, static_cast<int16_t>(b.x + 10),
            static_cast<int16_t>(b.y + 20), time_font, time_flat,
            textdatum_t::middle_left);

    // --- Date (small, under the time) ---
    static const char* kDows[] = {"Sun", "Mon", "Tue", "Wed", "Thu", "Fri", "Sat"};
    static const char* kMons[] = {"Jan", "Feb", "Mar", "Apr", "May", "Jun",
                                  "Jul", "Aug", "Sep", "Oct", "Nov", "Dec"};
    const int dow = (tm.tm_wday >= 0 && tm.tm_wday < 7) ? tm.tm_wday : 0;
    const int mon = (tm.tm_mon >= 0 && tm.tm_mon < 12) ? tm.tm_mon : 0;
    char date[32];
    std::snprintf(date, sizeof(date), "%s %d %s", kDows[dow], tm.tm_mday,
                  kMons[mon]);
    const text::FontPick small{&fonts::FreeSansBold12pt7b, 1};
    barText(g, date, static_cast<int16_t>(b.x + 10),
            static_cast<int16_t>(b.y + 47), small, theme::kInk,
            textdatum_t::middle_left);

    // --- Temperature + humidity (right) ---
    const auto& env = hal::sensors::last();
    const int16_t right = static_cast<int16_t>(b.right() - 10);

    if (env.valid) {
        char temp[16];
        std::snprintf(temp, sizeof(temp), "%.1f", env.temperature_c);
        const text::FontPick temp_font{&fonts::FreeSansBold18pt7b, 1};

        // Laid out right-to-left: "C", then the degree ring, then the number.
        barText(g, "C", right, static_cast<int16_t>(b.y + 20), temp_font,
                theme::kInk, textdatum_t::middle_right);
        const int16_t c_w = text::measure(g, "C", temp_font);
        const int16_t ring_x = static_cast<int16_t>(right - c_w - 8);
        drawDegreeRing(g, ring_x, static_cast<int16_t>(b.y + 11), theme::kBlack);
        if (theme::kStatusRainbow) {
            // A white halo so the ring reads over any band.
            g.drawCircle(ring_x, static_cast<int16_t>(b.y + 11), 4, theme::kWhite);
        }
        barText(g, temp, static_cast<int16_t>(ring_x - 6),
                static_cast<int16_t>(b.y + 20), temp_font, theme::kInk,
                textdatum_t::middle_right);

        char humi[16];
        std::snprintf(humi, sizeof(humi), "%.0f%% RH", env.humidity_pct);
        const int16_t humi_w = text::measure(g, humi, small);
        barText(g, humi, right, static_cast<int16_t>(b.y + 47), small,
                theme::kInk, textdatum_t::middle_right);

        // Battery sits to the left of the humidity reading, on the same row.
        const auto batt = hal::power::readBattery();
        drawBattery(g, static_cast<int16_t>(right - humi_w - 40),
                    static_cast<int16_t>(b.y + 47), batt);
    } else {
        barText(g, "-- C", right, static_cast<int16_t>(b.y + 20),
                text::FontPick{&fonts::FreeSansBold18pt7b, 1}, theme::kRed,
                textdatum_t::middle_right);
        barText(g, "no sensor", right, static_cast<int16_t>(b.y + 47), small,
                theme::kRed, textdatum_t::middle_right);
    }
}

}  // namespace ui
